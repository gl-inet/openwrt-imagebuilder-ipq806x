## build_dir/target-arm_cortex-a7_uClibc-1.0.14_eabi/linux-ipq806x/fit-qcom-ipq40xx-ap.dk04.1-c1.its
```
/dts-v1/;

/ {
	description = "ARM OpenWrt FIT (Flattened Image Tree)";
	#address-cells = <1>;

	images {
		kernel@1 {
			description = "ARM OpenWrt Linux-3.14.77";
			data = /incbin/("/home/han/misc/glweb/qsdk5-next/build_dir/target-arm_cortex-a7_uClibc-1.0.14_eabi/linux-ipq806x/Image-initramfs");
			type = "kernel";
			arch = "arm";
			os = "linux";
			compression = "none";
			load = <0x80208000>;
			entry = <0x80208000>;
			hash@1 {
				algo = "crc32";
			};
			hash@2 {
				algo = "sha1";
			};
		};


		fdt@1 {
			description = "ARM OpenWrt qcom-ipq40xx-ap.dk04.1-c1 device tree blob";
			data = /incbin/("/home/han/misc/glweb/qsdk5-next/build_dir/target-arm_cortex-a7_uClibc-1.0.14_eabi/linux-ipq806x/linux-3.14.77/arch/arm/boot/dts//qcom-ipq40xx-ap.dk04.1-c1.dtb");
			type = "flat_dt";
			arch = "arm";
			compression = "none";
			hash@1 {
				algo = "crc32";
			};
			hash@2 {
				algo = "sha1";
			};
		};


	};

	configurations {
		default = "config@1";

		config@1 {
			description = "OpenWrt";
			kernel = "kernel@1";
			fdt = "fdt@1";
		};

	};
};
```

## build_dir/target-arm_cortex-a7_uClibc-1.0.14_eabi/linux-ipq806x/fit-qcom-ipq40xx-ap.dkxx.its
```
/dts-v1/;

/ {
	description = "ARM OpenWrt FIT (Flattened Image Tree)";
	#address-cells = <1>;

	images {
		kernel@1 {
			description = "ARM OpenWrt Linux-3.14.77";
			data = /incbin/("/home/han/misc/glweb/qsdk5-next/build_dir/target-arm_cortex-a7_uClibc-1.0.14_eabi/linux-ipq806x/Image.gz");
			type = "kernel";
			arch = "arm";
			os = "linux";
			compression = "gzip";
			load = <0x80208000>;
			entry = <0x80208000>;
			hash@1 {
				algo = "crc32";
			};
			hash@2 {
				algo = "sha1";
			};
		};


		fdt@ap.dk07.1-c1 {
			description = "ARM OpenWrt qcom-ipq40xx-ap.dkxx device tree blob";
			data = /incbin/("/home/han/misc/glweb/qsdk5-next/build_dir/target-arm_cortex-a7_uClibc-1.0.14_eabi/linux-ipq806x/linux-3.14.77/arch/arm/boot/dts/qcom-ipq40xx-ap.dk07.1-c1.dtb");
			type = "flat_dt";
			arch = "arm";
			compression = "none";
			hash@1 {
				algo = "crc32";
			};
			hash@2 {
				algo = "sha1";
			};
		};

		fdt@ap.dk05.1-c1 {
			description = "ARM OpenWrt qcom-ipq40xx-ap.dkxx device tree blob";
			data = /incbin/("/home/han/misc/glweb/qsdk5-next/build_dir/target-arm_cortex-a7_uClibc-1.0.14_eabi/linux-ipq806x/linux-3.14.77/arch/arm/boot/dts/qcom-ipq40xx-ap.dk05.1-c1.dtb");
			type = "flat_dt";
			arch = "arm";
			compression = "none";
			hash@1 {
				algo = "crc32";
			};
			hash@2 {
				algo = "sha1";
			};
		};

		fdt@ap.dk06.1-c1 {
			description = "ARM OpenWrt qcom-ipq40xx-ap.dkxx device tree blob";
			data = /incbin/("/home/han/misc/glweb/qsdk5-next/build_dir/target-arm_cortex-a7_uClibc-1.0.14_eabi/linux-ipq806x/linux-3.14.77/arch/arm/boot/dts/qcom-ipq40xx-ap.dk06.1-c1.dtb");
			type = "flat_dt";
			arch = "arm";
			compression = "none";
			hash@1 {
				algo = "crc32";
			};
			hash@2 {
				algo = "sha1";
			};
		};

		fdt@ap.dk04.1-c1 {
			description = "ARM OpenWrt qcom-ipq40xx-ap.dkxx device tree blob";
			data = /incbin/("/home/han/misc/glweb/qsdk5-next/build_dir/target-arm_cortex-a7_uClibc-1.0.14_eabi/linux-ipq806x/linux-3.14.77/arch/arm/boot/dts/qcom-ipq40xx-ap.dk04.1-c1.dtb");
			type = "flat_dt";
			arch = "arm";
			compression = "none";
			hash@1 {
				algo = "crc32";
			};
			hash@2 {
				algo = "sha1";
			};
		};

		fdt@ap.dk04.1-c5 {
			description = "ARM OpenWrt qcom-ipq40xx-ap.dkxx device tree blob";
			data = /incbin/("/home/han/misc/glweb/qsdk5-next/build_dir/target-arm_cortex-a7_uClibc-1.0.14_eabi/linux-ipq806x/linux-3.14.77/arch/arm/boot/dts/qcom-ipq40xx-ap.dk04.1-c5.dtb");
			type = "flat_dt";
			arch = "arm";
			compression = "none";
			hash@1 {
				algo = "crc32";
			};
			hash@2 {
				algo = "sha1";
			};
		};

		fdt@ap.dk07.1-c2 {
			description = "ARM OpenWrt qcom-ipq40xx-ap.dkxx device tree blob";
			data = /incbin/("/home/han/misc/glweb/qsdk5-next/build_dir/target-arm_cortex-a7_uClibc-1.0.14_eabi/linux-ipq806x/linux-3.14.77/arch/arm/boot/dts/qcom-ipq40xx-ap.dk07.1-c2.dtb");
			type = "flat_dt";
			arch = "arm";
			compression = "none";
			hash@1 {
				algo = "crc32";
			};
			hash@2 {
				algo = "sha1";
			};
		};

		fdt@ap.dk01.1-c1 {
			description = "ARM OpenWrt qcom-ipq40xx-ap.dkxx device tree blob";
			data = /incbin/("/home/han/misc/glweb/qsdk5-next/build_dir/target-arm_cortex-a7_uClibc-1.0.14_eabi/linux-ipq806x/linux-3.14.77/arch/arm/boot/dts/qcom-ipq40xx-ap.dk01.1-c1.dtb");
			type = "flat_dt";
			arch = "arm";
			compression = "none";
			hash@1 {
				algo = "crc32";
			};
			hash@2 {
				algo = "sha1";
			};
		};

		fdt@ap.dk04.1-c4 {
			description = "ARM OpenWrt qcom-ipq40xx-ap.dkxx device tree blob";
			data = /incbin/("/home/han/misc/glweb/qsdk5-next/build_dir/target-arm_cortex-a7_uClibc-1.0.14_eabi/linux-ipq806x/linux-3.14.77/arch/arm/boot/dts/qcom-ipq40xx-ap.dk04.1-c4.dtb");
			type = "flat_dt";
			arch = "arm";
			compression = "none";
			hash@1 {
				algo = "crc32";
			};
			hash@2 {
				algo = "sha1";
			};
		};

		fdt@ap.dk04.1-c3 {
			description = "ARM OpenWrt qcom-ipq40xx-ap.dkxx device tree blob";
			data = /incbin/("/home/han/misc/glweb/qsdk5-next/build_dir/target-arm_cortex-a7_uClibc-1.0.14_eabi/linux-ipq806x/linux-3.14.77/arch/arm/boot/dts/qcom-ipq40xx-ap.dk04.1-c3.dtb");
			type = "flat_dt";
			arch = "arm";
			compression = "none";
			hash@1 {
				algo = "crc32";
			};
			hash@2 {
				algo = "sha1";
			};
		};

		fdt@ap.dk04.1-c2 {
			description = "ARM OpenWrt qcom-ipq40xx-ap.dkxx device tree blob";
			data = /incbin/("/home/han/misc/glweb/qsdk5-next/build_dir/target-arm_cortex-a7_uClibc-1.0.14_eabi/linux-ipq806x/linux-3.14.77/arch/arm/boot/dts/qcom-ipq40xx-ap.dk04.1-c2.dtb");
			type = "flat_dt";
			arch = "arm";
			compression = "none";
			hash@1 {
				algo = "crc32";
			};
			hash@2 {
				algo = "sha1";
			};
		};

		fdt@ap.dk01.1-c2 {
			description = "ARM OpenWrt qcom-ipq40xx-ap.dkxx device tree blob";
			data = /incbin/("/home/han/misc/glweb/qsdk5-next/build_dir/target-arm_cortex-a7_uClibc-1.0.14_eabi/linux-ipq806x/linux-3.14.77/arch/arm/boot/dts/qcom-ipq40xx-ap.dk01.1-c2.dtb");
			type = "flat_dt";
			arch = "arm";
			compression = "none";
			hash@1 {
				algo = "crc32";
			};
			hash@2 {
				algo = "sha1";
			};
		};

		fdt@ap.dk01.1-c3 {
			description = "ARM OpenWrt qcom-ipq40xx-ap.dkxx device tree blob";
			data = /incbin/("/home/han/misc/glweb/qsdk5-next/build_dir/target-arm_cortex-a7_uClibc-1.0.14_eabi/linux-ipq806x/linux-3.14.77/arch/arm/boot/dts/qcom-ipq40xx-ap.dk01.1-c3.dtb");
			type = "flat_dt";
			arch = "arm";
			compression = "none";
			hash@1 {
				algo = "crc32";
			};
			hash@2 {
				algo = "sha1";
			};
		};

		fdt@db.dk02.1-c1 {
			description = "ARM OpenWrt qcom-ipq40xx-ap.dkxx device tree blob";
			data = /incbin/("/home/han/misc/glweb/qsdk5-next/build_dir/target-arm_cortex-a7_uClibc-1.0.14_eabi/linux-ipq806x/linux-3.14.77/arch/arm/boot/dts/qcom-ipq40xx-db.dk02.1-c1.dtb");
			type = "flat_dt";
			arch = "arm";
			compression = "none";
			hash@1 {
				algo = "crc32";
			};
			hash@2 {
				algo = "sha1";
			};
		};

		fdt@db.dk01.1-c1 {
			description = "ARM OpenWrt qcom-ipq40xx-ap.dkxx device tree blob";
			data = /incbin/("/home/han/misc/glweb/qsdk5-next/build_dir/target-arm_cortex-a7_uClibc-1.0.14_eabi/linux-ipq806x/linux-3.14.77/arch/arm/boot/dts/qcom-ipq40xx-db.dk01.1-c1.dtb");
			type = "flat_dt";
			arch = "arm";
			compression = "none";
			hash@1 {
				algo = "crc32";
			};
			hash@2 {
				algo = "sha1";
			};
		};


	};

	configurations {
		default = "config@db.dk01.1-c1";

		config@ap.dk07.1-c1 {
			description = "OpenWrt";
			kernel = "kernel@1";
			fdt = "fdt@ap.dk07.1-c1";
		};

		config@ap.dk05.1-c1 {
			description = "OpenWrt";
			kernel = "kernel@1";
			fdt = "fdt@ap.dk05.1-c1";
		};

		config@ap.dk06.1-c1 {
			description = "OpenWrt";
			kernel = "kernel@1";
			fdt = "fdt@ap.dk06.1-c1";
		};

		config@ap.dk04.1-c1 {
			description = "OpenWrt";
			kernel = "kernel@1";
			fdt = "fdt@ap.dk04.1-c1";
		};

		config@ap.dk04.1-c5 {
			description = "OpenWrt";
			kernel = "kernel@1";
			fdt = "fdt@ap.dk04.1-c5";
		};

		config@ap.dk07.1-c2 {
			description = "OpenWrt";
			kernel = "kernel@1";
			fdt = "fdt@ap.dk07.1-c2";
		};

		config@ap.dk01.1-c1 {
			description = "OpenWrt";
			kernel = "kernel@1";
			fdt = "fdt@ap.dk01.1-c1";
		};

		config@ap.dk04.1-c4 {
			description = "OpenWrt";
			kernel = "kernel@1";
			fdt = "fdt@ap.dk04.1-c4";
		};

		config@ap.dk04.1-c3 {
			description = "OpenWrt";
			kernel = "kernel@1";
			fdt = "fdt@ap.dk04.1-c3";
		};

		config@ap.dk04.1-c2 {
			description = "OpenWrt";
			kernel = "kernel@1";
			fdt = "fdt@ap.dk04.1-c2";
		};

		config@ap.dk01.1-c2 {
			description = "OpenWrt";
			kernel = "kernel@1";
			fdt = "fdt@ap.dk01.1-c2";
		};

		config@ap.dk01.1-c3 {
			description = "OpenWrt";
			kernel = "kernel@1";
			fdt = "fdt@ap.dk01.1-c3";
		};

		config@db.dk02.1-c1 {
			description = "OpenWrt";
			kernel = "kernel@1";
			fdt = "fdt@db.dk02.1-c1";
		};

		config@db.dk01.1-c1 {
			description = "OpenWrt";
			kernel = "kernel@1";
			fdt = "fdt@db.dk01.1-c1";
		};

	};
};
```
